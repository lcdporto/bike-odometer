## firmware/boards/LCD/bike-odometer/Kconfig.bike-odometer
```kconfig
config BOARD_BIKE_ODOMETER
	bool
	select SOC_NRF54L10_CPUAPP if BOARD_BIKE_ODOMETER_NRF54L10_CPUAPP
```

## firmware/boards/LCD/bike-odometer/Kconfig.defconfig
```kconfig
config HW_STACK_PROTECTION
	default ARCH_HAS_STACK_PROTECTION

if BOARD_BIKE_ODOMETER

config ROM_START_OFFSET
	default 0 if PARTITION_MANAGER_ENABLED
	default 0x800 if BOOTLOADER_MCUBOOT

endif # BOARD_BIKE_ODOMETER
```

## firmware/boards/LCD/bike-odometer/board.yml
```yaml
board:
  name: bike-odometer
  full_name: Bike Odometer
  vendor: LCD
  socs:
  - name: nrf54l10
```
